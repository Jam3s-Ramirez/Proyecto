//*****************
// Universidad del Valle de Guatemala
// IE2023: Programación de Microcontroladores 
// Autor: James Ramírez
// Proyecto: Proyecto-1-reloj
// Descripción: Reloj, fecha y alarma
// Hardware: ATMEGA328P
// Created: 21/02/2024 15:41:19
//******************
// Encabezado 
//******************
.include "M328PDEF.inc"
.cseg 
//REGISTROS UTILIZADOS PARA CADA FUNCIÓN
.def ESTADO = R0
.def UMIN = R1
.def DMIN = R2
.def UHOR = R3
.def DHOR = R4
.def UMINALARM = R5
.def DMINALARM = R6
.def UHORALARM = R7
.def DHORALARM = R8
.def UDIA = R9
.def DDIA = R10
.def UMES = R11
.def DMES = R12
.def SEGUNDOS = R13
.org 0x00
	JMP MAIN   //Programa principal 
.org 0x0006
	JMP INT_PC  //Interrupciones por push 
.org 0x0020
	JMP INT_TIMER0  //Interrupcción del timer0
//******************
//Configuración de la Pila
//******************
MAIN: 
LDI R16, LOW(RAMEND)
OUT SPL, R16
LDI R17, HIGH(RAMEND)
OUT SPH, R17

//******************

//******************
//Configuración MCU
//******************
SETUP:
	LDI R16, 0b1000_0000		//el timer se establece a 8MHz
	LDI R16, (1 << CLKPCE)
	STS CLKPR, R16

	LDI R16, 0b0000_0001
	STS CLKPR, R16

	LDI R16, 0b0000_0000		//Configuración al puerto B como pull ups
	OUT DDRB, R16

	LDI R16, 0b0001_1111		//Configuramos al pueto B como entradas y salidas
	OUT	PORTB, R16

	LDI R16, 0b0011_1111		//Configuramos el puerto C como salidas
	OUT DDRC, R16

	LDI R16, 0b1111_1111		//Configuramos el puerto D como salidas
	OUT DDRD, R16

	LDI R16, (1<<PCINT0)|(1<<PCINT1)|(1<<PCINT2)|(1<<PCINT3)|(1<<PCINT4)    //Se establecen los pines 0-4 del puerto b como interrupciones
	STS PCMSK0, R16

	LDI R16, (1<<PCIE0)			//SE HABILITAN LAS INTERRUPCIONES POR CAMBIO DE PIN EN EL PORTB
	STS PCICR, R16

	LDI	R16, 0x00
	STS	UCSR0B, R16				
	LDI R16, (1<<PCIE0)

	SEI							//SE HABILITAN LAS INTERRUPCIONES

	CLR ESTADO
	CLR UMIN
	CLR DMIN
	CLR UHOR
	CLR DHOR
	CLR UMINALARM
	CLR DMINALARM
	CLR UHORALARM
	CLR UHORALARM
	CLR SEGUNDOS
	CLR R20
	CLR	DDIA
	CLR	DMES
	LDI R16, 1
	MOV UDIA, R16
	MOV UMES, R16

	CALL INT_T0		// SE INICIA EL TIMER0 EN MODO NORMAL

//********************************
//Configuración del	LOOP
//********************************

LOOP:

	MOV R16, ESTADO		;MOSTRAR FECHA
	CPI R16, 0
	BREQ SALTO000

	CPI R16, 1			;MOSTRAR HORA
	BREQ SALTO001

	CPI R16, 2			;CONFIG HORA
	BREQ SALTO010
		
	CPI R16, 3			;CONFIG FECHA
	BREQ SALTO011

	/*CPI R16, 4			;MOSTRAR ALARMA
	BREQ SALTO100

	CPI R16, 5			;CONFIG ALARMA
	BREQ SALTO101*/

	CPI R16, 4
	CLR ESTADO

	JMP LOOP

SALTO000:
	JMP ESTADO000

SALTO001:
	JMP ESTADO001

SALTO010:
	JMP ESTADO010

SALTO011:
	JMP ESTADO011

SALTO100:
	JMP ESTADO100

SALTO101:
	JMP ESTADO101


ESTADO000:	;MOSTRAR HORA

	LDI R16, 0b0000_1110		;MULTIPLEXACIÓN DE LOS DISPLAY
	OUT PORTC, R16

	LDI ZH, HIGH(TABLA7SEG << 1)  ;SE MUESTRA EL VALOR DE LAS DECENAS DE LAS HORAS
	LDI ZL, LOW(TABLA7SEG << 1)
	ADD ZL, DHOR
	LPM R30, Z
	OUT PORTD, R30
	  
	CALL DELAY
	
	LDI R16, 0b0000_1101		;MULTIPLEXACIÓN DE LOS DISPLAY
	OUT PORTC, R16

	LDI ZH, HIGH(TABLA7SEG << 1)  ;SE MUESTRA EL VALOR DE LAS UNIDADES DE LAS HORAS
	LDI ZL, LOW(TABLA7SEG << 1)
	ADD ZL, UHOR
	LPM R30, Z
	OUT PORTD, R30 

	CALL DELAY
	
	LDI R16, 0b0000_1011		;MULTIPLEXACIÓN DE LOS DISPLAY
	OUT PORTC, R16

	LDI ZH, HIGH(TABLA7SEG << 1)  ;SE MUESTRA EL VALOR DE LAS DECENAS DE LOS MINUTOS 
	LDI ZL, LOW(TABLA7SEG << 1)
	ADD ZL, DMIN
	LPM R30, Z
	OUT PORTD, R30
	
	CALL DELAY

	LDI R16, 0b0000_0111		;MULTIPLEXACIÓN DE LOS DISPLAY
	OUT PORTC, R16

	LDI ZH, HIGH(TABLA7SEG << 1)  ;SE MUESTRA EL VALOR DE LAS UNIDADES DE LOS MINUTOS
	LDI ZL, LOW(TABLA7SEG << 1)
	ADD ZL, UMIN
	LPM R30, Z
	OUT PORTD, R30 
	
	CALL DELAY

	CPI R20, 50
	BREQ AUMENTAR_SEGUNDOS		; SE ESTABLECE UN CONTADOR PARA ALCANZAR LA DURACIÓN DE UN SEGUNDO

	MOV R16, SEGUNDOS			; SE REALIZA UNA COMPARACIÓN PARA QUE AL MOMENTO DE LLEGAR EL REGISTRO SEGUNDOS A 61, SE INCREMENTE EL REGISTRO UMIN
	CPI R16, 61
	BREQ AUMENTAR_UMIN
	
	MOV R16, UMIN				; SE ESTABLECE UNA COMPARACIÓN PARA QUE AL MOMENTO QUE EL REGISTRO UMIN LLEGUE A 10, REGRESE A 0 Y AUMENTE EL REGISTRO DMIN
	CPI R16, 10
	BREQ AUMENTAR_DMIN

	MOV R16, DMIN				; SE ESTABLECE UNA COMPARACIÓN PARA QUE AL MOMENTO QUE EL REGISTRO DMIN LLEGUE A 6, SE RESETEA UMIN, DMIN Y SE AUMENTA UHOR
	CPI R16, 6
	BREQ AUMENTAR_UHOR

	MOV R16, UHOR				; SE ESTABLECE UNA COMPARACIÓN PARA QUE AL MOMENTO QUE EL REGISTRO UHOR LLEGUE A 10, REGRESE A 0 Y AUMENTE EL REGISTRO DHOR
	CPI R16, 10
	BREQ AUMENTAR_DHOR

	MOV R16, DHOR				; SE REALIZA UNA COMPARACIÓN PARA VERIFICAR QUE AL MOMENTO DEL REGISTRO DHOR ESTÉ EN 2, UHOR NO PASE DE 4 PARA QUE EL FORMATO DE
	CPI R16, 2					; SE MANTENGA EN 24 HORAS, CUANDO SE ALCANZA EL VALOR DE 23:59, TODAS LAS VARIABLES DE HORA SE RESETEAN Y SE AUMENTA LA VARIABLE 
	BREQ VERIFICAR				; DE LAS UNIDADES DE LOS DÍAS

	JMP LOOP

	AUMENTAR_SEGUNDOS:
	CLR R20
	LDI R16, 0b001_0000
	OUT PORTC, R16
	CALL DELAY_LED
	INC SEGUNDOS
	JMP ESTADO000

	AUMENTAR_UMIN:
	CLR SEGUNDOS
	INC UMIN
	JMP ESTADO000

	AUMENTAR_DMIN:
	CLR UMIN
	INC DMIN
	JMP ESTADO000

	AUMENTAR_UHOR:
	CLR DMIN
	INC UHOR
	JMP ESTADO000

	AUMENTAR_DHOR:
	CLR UHOR
	INC DHOR
	JMP ESTADO000

	VERIFICAR:
	MOV R16, UHOR
	CPI R16, 4
	BREQ RESET_HORA
	JMP ESTADO000

	RESET_HORA:
	INC UDIA
	CLR DHOR
	CLR UHOR
	CLR DMIN
	CLR UMIN
	CLR SEGUNDOS
	CLR R20
	JMP ESTADO000


ESTADO001:	;MOSTRAR FECHA

	LDI R16, 0b0000_1110		;MULTIPLEXACIÓN
	OUT PORTC, R16

	LDI ZH, HIGH(TABLA7SEG << 1)  ;SE MUESTRA EL VALOR DE LAS DECENAS DE LOS MESES
	LDI ZL, LOW(TABLA7SEG << 1)
	ADD ZL, DMES
	LPM R30, Z
	OUT PORTD, R30
	  
	CALL DELAY
	
	LDI R16, 0b0000_1101		;MULTIPLEXACIÓN
	OUT PORTC, R16

	LDI ZH, HIGH(TABLA7SEG << 1)  ;SE MUESTRA EL VALOR DE LAS UNIDADES DE LOS MESES
	LDI ZL, LOW(TABLA7SEG << 1)
	ADD ZL, UMES
	LPM R30, Z
	OUT PORTD, R30 

	CALL DELAY
	
	LDI R16, 0b0000_1011		;MULTIPLEXACIÓN
	OUT PORTC, R16

	LDI ZH, HIGH(TABLA7SEG << 1)	;SE MUESTRA EL VALOR DE LAS DECENAS DE LOS DÍAS 
	LDI ZL, LOW(TABLA7SEG << 1)
	ADD ZL, DDIA
	LPM R30, Z
	OUT PORTD, R30
	
	CALL DELAY

	LDI R16, 0b0000_0111		;MULTIPLEXACIÓN
	OUT PORTC, R16

	LDI ZH, HIGH(TABLA7SEG << 1)	;SE MUESTRA EL VALOR DE LAS UNIDADES DE LOS DÍAS
	LDI ZL, LOW(TABLA7SEG << 1)
	ADD ZL, UDIA
	LPM R30, Z
	OUT PORTD, R30 

	CALL DELAY

	MOV R16, UDIA			; SE REALIZA UNA COMPARACIÓN PARA QUE AL MOMENTO QUE EL REGISTRO UDIA LLEGUE A 10, SE RESETEE Y AUMENTE EL REGISTRO DDIA
	CPI R16, 10
	BREQ AUMENTAR_DDIA

	MOV R16, DDIA			; SE REALIZA UNA COMPARACIÓN PARA QUE AL MOMENTO QUE EL REGISTRO DDIA LLEGUE A 3, SE RESETEE Y AUMENTE EL REGISTRO UMES
	CPI R16, 3
	BREQ VERIFICAR_DDIA

	MOV R16, UMES			; SE REALIZA UNA COMPARACIÓN PARA QUE AL MOMENTO QUE EL REGISTRO UMES LLEGUE A 10, SE RESETEE Y AUMENTE EL REGISTRO DMES
	CPI R16, 10
	BREQ AUMENTAR_DMES

	MOV R16, DMES			; SE REALIZA UNA COMPARACIÓN PARA VERIFICAR QUE AL MOMENTO QUE EL REIGSTRO DMES ESTÉ EN 1, EL REGISTRO UMES NO PASE DE 2, 
	CPI R16, 1				; ESTO PARA MANTENER EL FORMATO DE LOS 12 MESES DE LA FECHA
	BREQ VERIFICAR_UMES


	AUMENTAR_DDIA:
	LDI R16, 1
	MOV UDIA, R16
	INC DDIA
	JMP ESTADO011

	VERIFICAR_DDIA:
	MOV R16, UDIA
	CPI R16, 2
	BREQ RESET_DIA
	JMP ESTADO011

	RESET_DIA:
	LDI R16, 1
	MOV UDIA, R16
	CLR DDIA
	JMP ESTADO011

	AUMENTAR_DMES:
	CLR UMES
	INC DMES
	JMP ESTADO011

	VERIFICAR_UMES:
	MOV R16, UMES
	CPI R16, 3
	BREQ RESET_MES
	JMP ESTADO011

	RESET_MES:
	LDI R16, 1
	MOV UMES, R16
	CLR DMES
	JMP ESTADO011

	JMP LOOP

ESTADO010:	;CONFIG HORA

	LDI R16, 0b0000_1110		;MULTIPLEXACIÓN
	OUT PORTC, R16

	LDI ZH, HIGH(TABLA7SEG << 1)  ;SE MUESTRA EL VALOR DE LAS DECENAS DE LAS HORAS
	LDI ZL, LOW(TABLA7SEG << 1)
	ADD ZL, DHOR
	LPM R30, Z
	OUT PORTD, R30
	  
	CALL DELAY
	
	LDI R16, 0b0000_1101		;MULTIPLEXACIÓN
	OUT PORTC, R16

	LDI ZH, HIGH(TABLA7SEG << 1)  ;SE MUESTRA EL VALOR DE LAS UNIDADES DE LAS HORAS
	LDI ZL, LOW(TABLA7SEG << 1)
	ADD ZL, UHOR
	LPM R30, Z
	OUT PORTD, R30 

	CALL DELAY
	
	LDI R16, 0b0000_1011		;MULTIPLEXACIÓN
	OUT PORTC, R16

	LDI ZH, HIGH(TABLA7SEG << 1)  ;SE MUESTRA EL VALOR DE LAS DECENAS DE LOS MINUTOS
	LDI ZL, LOW(TABLA7SEG << 1)
	ADD ZL, DMIN
	LPM R30, Z
	OUT PORTD, R30
	
	CALL DELAY

	LDI R16, 0b0000_0111		;MULTIPLEXACIÓN
	OUT PORTC, R16

	LDI ZH, HIGH(TABLA7SEG << 1)  ;SE MUESTRA EL VALOR DE LAS UNIDADES DE LOS MINUTOS
	LDI ZL, LOW(TABLA7SEG << 1)
	ADD ZL, UMIN
	LPM R30, Z
	OUT PORTD, R30 
	
	CALL DELAY

	
MOV R16, UMIN				;SE REALIZA UNA COMPARACIÓN PARA QUE AL MOMENTO QUE EL REGISTRO UMIN LLEGUE A 10, SE RESETEE Y AUMENTE 
CPI R16, 10					;EL VALOR DEL REGISTRO DMIN
BREQ CONFIG_AUMENTAR_DMIN

CPI R16, -1					;SE REALIZA UNA COMPARACIÓN PARA QUE AL MOMENTO QUE EL REGISTRO UMIN ESTÉ EN -1, REALICE UN DECREMENTO 
BREQ DEC_DMIN				;EN EL REGISTRO DMIN

MOV R16, DMIN				;SE REALIZA UNA COMPARACIÓN PARA QUE AL MOMENTO QUE EL REGISTRO DMIN LLEGUE A 6, SE RESETEEN LOS RESGISTROS 
CPI R16, 6					;DMIN Y UMIN REALIZANDO ASÍ EL OVERFLOW
BREQ RESET_MINUTOS

CPI R16, -1					;SE REALIZA UNA COMPARACIÓN PARA QUE AL MOMENTO QUE EL REGISTRO DMIN ESTÉ EN -1, LOS REGISTROS DMIN Y UMIN  
BREQ UNDERFLOW_MINUTOS		;TOMEN EL VALOR DE 5 Y 9 RESPECTIVAMENTE PARA REALIZAR EL UNDERFLOW DE LOS MINUTOS

MOV R16, UHOR				;SE REALIZA UNA COMPARACIÓN PARA QUE AL MOMENTO QUE EL REGISTRO UHOR LLEGUE A 10, SE RESETEE Y AUMENTE 
CPI R16, 10					;EL VALOR DEL REGISTRO DHOR
BREQ CONFIG_AUMENTAR_DHOR

CPI R16, -1					;SE REALIZA UNA COMPARACIÓN PARA QUE AL MOMENTO QUE EL REGISTRO UHOR ESTÉ EN -1, REALICE UN DECREMENTO 
BREQ DEC_DHOR				;EN EL REGISTRO DHOR

MOV R16, DHOR				;SE REALIZA UNA COMPARACIÓN PARA QUE AL MOMENTO QUE EL REGISTRO DHOR ESTÉ EN 2, SE VERIFIQUE EL VALOR 
CPI R16, 2					;DEL REGISTRO UHOR PARA QUE EL VALOR DE LOS DOS REGISTROS NO SUPERE EL VALOR DE 23, ESTO PARA QUE EL 
BREQ CONFIG_VERIFICAR		;FORMATO SE MANTENGA EN 24 HORAS Y REALIZAR EL OVERFLOW

CPI R16, -1					;SE REALIZA UNA COMPARACIÓN PARA QUE AL MOMENTO QUE EL REGISTRO DHOR ESTÉ EN -1, LOS REGISTROS DHOR Y UHOR 	
BREQ UNDERFLOW_HORA			;TOMEN EL VALOR DE 2 Y 3 RESPECTIVAMENTE PARA REALIZAR EL UNDERFLOW DE LAS HORAS

JMP LOOP

CONFIG_AUMENTAR_DMIN:
CLR UMIN
INC DMIN
JMP ESTADO010

DEC_DMIN:
DEC DMIN
LDI R16, 9
MOV UMIN, R16
JMP ESTADO010

RESET_MINUTOS:
CLR UMIN
CLR DMIN
JMP ESTADO010

UNDERFLOW_MINUTOS:
LDI R16, 5
MOV DMIN, R16
LDI R16, 9
MOV UMIN, R16
JMP ESTADO010

CONFIG_AUMENTAR_DHOR:
INC DHOR
CLR UHOR
JMP ESTADO010

DEC_DHOR:
DEC DHOR
LDI R16, 9
MOV UHOR, R16
JMP ESTADO010

CONFIG_VERIFICAR:
MOV R16, UHOR
CPI R16, 4
BREQ CONFIG_RESET_HORA
JMP ESTADO010

CONFIG_RESET_HORA:
CLR DHOR
CLR UHOR
JMP ESTADO010

UNDERFLOW_HORA:
LDI R16, 2
MOV DHOR, R16
LDI R16, 3
MOV UHOR, R16
JMP ESTADO010


ESTADO011:	;CONFIG FECHA

	LDI R16, 0b0000_1110		;MULTIPLEXACIÓN
	OUT PORTC, R16

	LDI ZH, HIGH(TABLA7SEG << 1)  ;SE MUESTRA EL VALOR DE LAS DECENAS DE LOS MESES
	LDI ZL, LOW(TABLA7SEG << 1)
	ADD ZL, DMES
	LPM R30, Z
	OUT PORTD, R30
	  
	CALL DELAY
	
	LDI R16, 0b0000_1101		;MULTIPLEXACIÓN
	OUT PORTC, R16

	LDI ZH, HIGH(TABLA7SEG << 1)  ;SE MUESTRA EL VALOR DE LAS UNIDADES DE LOS MESES
	LDI ZL, LOW(TABLA7SEG << 1)
	ADD ZL, UMES
	LPM R30, Z
	OUT PORTD, R30 

	CALL DELAY
	
	LDI R16, 0b0000_1011		;MULTIPLEXACIÓN
	OUT PORTC, R16

	LDI ZH, HIGH(TABLA7SEG << 1)  ;SE MUESTRA EL VALOR DE LAS DECENAS DE LOS DÍAS 
	LDI ZL, LOW(TABLA7SEG << 1)
	ADD ZL, DDIA
	LPM R30, Z
	OUT PORTD, R30
	
	CALL DELAY

	LDI R16, 0b0000_0111		;MULTIPLEXACIÓN
	OUT PORTC, R16

	LDI ZH, HIGH(TABLA7SEG << 1)  ;SE MUESTRA EL VALOR DE LAS UNIDADES DE LOS DÍAS 
	LDI ZL, LOW(TABLA7SEG << 1)
	ADD ZL, UDIA
	LPM R30, Z
	OUT PORTD, R30 
	
	CALL DELAY

MOV R16, UDIA					;SE REALIZA UNA COMPARACIÓN PARA QUE AL MOMENTO QUE EL REGISTRO UDIA LLEGUE A 10, SE RESETEE 
CPI R16, 10						;Y SE AUMENTE EL REGISTRO DDIA
BREQ CONFIG_AUMENTAR_DDIA

CPI R16, 0						;SE REALIZA UNA COMPARACIÓN DE UDIA CUANDO ESTÉ EN 0, LUEGO SE REALIZA UNA COMPARACIÓN DE DIA  
BREQ VERIFICAR_DEC_DDIA			;PARA QUE CUANDO ESTÉ EN 0, UDIA Y DDIA SE ESTABLEZCAN EN 1 Y 3 RESPECTIVAMENTE REALIZANDO 
								;EL UNDERFLOW, DE LO CONTRARIO, SE DECREMENTA EL REGISTRO DDIA

MOV R16, DDIA					;SE COMPARA EL REGISTRO DDIA CUANDO LLEGUE A 3 Y SE VERIFICA EL REGISTRO UDIA PARA QUE CUANDO 
CPI R16, 3						;ESTE ÚLTIMO LLEGUE A 1, SE REALICE EL OVERFLOW DE LOS DÍAS
BREQ CONFIG_VERIFICAR_DDIA

CPI R16, -1						;SE REALIZA UNA COMPARACIÓN PARA QUE AL MOMENTO QUE DDIA LLEGUE A -1, SE REALICE EL UNDERFLOW 
BREQ UNDERFLOW_DIAS				;DE LOS DÍAS ESTABLECIENDO DDIA Y UDIA EN 3 Y 1 RESPECTIVAMENTE

MOV R16, UMES					;SE REALIZA UNA COMPARACIÓN PARA QUE AL MOMENTO QUE EL REGISTRO UMES LLEGUE A 10, SE RESETEE 
CPI R16, 10						;Y SE AUMENTE EL REGISTRO DMES
BREQ CONFIG_AUMENTAR_DMES

CPI R16, 0						;SE REALIZA UNA COMPARACIÓN DE UMES CUANDO ESTÉ EN 0, LUEGO SE REALIZA UNA COMPARACIÓN DE DMES 
BREQ CONFIG_VERIFICAR_DEC_DMES	;PARA QUE CUANDO ESTÉ EN 0, UMES Y DMES SE ESTABLEZCAN EN 2 Y 1 RESPECTIVAMENTE 
								;REALIZANDO EL UNDERFLOW, DE LO CONTRARIO, SE DECREMENTA EL REGISTRO DDIA

MOV R16, DMES					;SE COMPARA EL REGISTRO DMES CUANDO LLEGUE A 1 Y SE VERIFICA EL REGISTRO UMES PARA QUE CUANDO 
CPI R16, 1						;ESTE ÚLTIMO LLEGUE A 2, SE REALICE EL OVERFLOW DE LOS MESES
BREQ CONFIG_VERIFICAR_UMES

CPI R16, -1						;SE REALIZA UNA COMPARACIÓN PARA QUE AL MOMENTO QUE DDIA LLEGUE A -1, SE REALICE EL UNDERFLOW 
BREQ UNDERFLOW_MES				;DE LOS DÍAS ESTABLECIENDO DMES Y UMES EN 1 Y 2 RESPECTIVAMENTE

JMP LOOP

CONFIG_AUMENTAR_DDIA:
LDI R16, 1
MOV UDIA, R16
INC DDIA
JMP ESTADO011

VERIFICAR_DEC_DDIA:
MOV R16, DDIA
CPI R16, 0
DEC DDIA
LDI R16, 9
MOV UDIA, R16
JMP ESTADO011

CONFIG_VERIFICAR_DDIA:
MOV R16, UDIA
CPI R16, 2
BREQ CONFIG_RESET_DIA
JMP ESTADO011

UNDERFLOW_DIAS:
LDI R16, 3
MOV DDIA, R16
LDI R16, 1
MOV UDIA, R16
JMP ESTADO011

CONFIG_AUMENTAR_DMES:
CLR UMES
INC DMES
JMP ESTADO011

CONFIG_VERIFICAR_DEC_DMES:
MOV R16, DMES
CPI R16, 0
DEC DMES
LDI R16, 9
MOV UMES, R16
JMP ESTADO011

CONFIG_VERIFICAR_UMES:
MOV R16, UMES
CPI R16, 3
BREQ CONFIG_RESET_MES
JMP ESTADO011

CONFIG_RESET_MES:
LDI R16, 1
MOV UMES, R16
CLR DMES
JMP ESTADO011

UNDERFLOW_MES:
LDI R16, 1
MOV DMES, R16
LDI R16, 2
MOV UMES, R16
JMP ESTADO011

CONFIG_RESET_DIA:
LDI R16, 1
MOV UDIA, R16
CLR DDIA
JMP ESTADO011


ESTADO100:	;CONFIG	ALARMA

	JMP LOOP

ESTADO101:	;MOSTRAR ALARMA

	JMP LOOP


DELAY:              //Delay para la multiplexación
	LDI R19, 255
DELAY1:
	DEC R19
	BRNE DELAY1 
	LDI R19, 255
DELAY2:
	DEC R19
	BRNE DELAY2
	LDI R19, 255
DELAY3:
	DEC R19
	BRNE DELAY3
	LDI R19, 255
DELAY4:
	DEC R19
	BRNE DELAY4
	RET

DELAY_LED:              //Delay para el parpadeo del led de los segundos
	LDI R19, 20
DELAY_LED1:
	DEC R19
	BRNE DELAY1 
	RET

TABLA7SEG: .DB 0x7E, 0x0C, 0xB6, 0x9E, 0xCC, 0xDA, 0xFA, 0x0E, 0xFE, 0xDE	;TABLA PARA EL DESPLIEGUE DE VALORES EN EL DISPLAY DE 7 SEGMENTOS

//******************
//INTERRUPCCIONES 
//******************
INT_PC:
	PUSH R16
	IN R16, SREG
	PUSH R16
	PUSH R17

	IN R16, PINB		;LECTURA DEL PINB PARA REALIZAR LA MAQUINA DE ESTADOS
	SBRS R16, PB4
	INC ESTADO			;SE INCREMENTA EL VALOR DEL REGISTRO ESTADO CADA VEZ QUE SE APACHE EL PUSH DEL PB4
	MOV R17, ESTADO
	
	CPI R17, 2			;SE REALIZAN COMPARACIONES DEL REGISTRO ESTADO PARA SABER A QUÉ MÓDULO SE DEBE MOVER
	BREQ INT_ESTADO010	;CONFIGURACIÓN DE HORA
	CPI R17, 3
	BREQ INT_ESTADO011	;CONFIGURACIÓN DE FECHA
	/*CPI R17, 4
	BREQ INT_ESTADO100
	*/
	CPI R17, 4			;CUANDO EL REGISTRO ESTADO LLEGA AL VALOR DE 4, SE RESETEA 
	BREQ LIMPIAR_ESTADO
	
	JMP INT_PC_POP		;SALIDA

INT_ESTADO010:	;CONFIG MIN Y HORA

	SBRS R16, PB0	;PB0 = 1?
	INC UMIN		;PB0 = 0
					;PB0 = 1
	SBRS R16, PB1	;PB1 = 1?
	DEC UMIN		;PB1 = 0
					;PB1 = 1
	SBRS R16, PB2	;PB2 = 1?
	INC UHOR		;PB2 = 0
					;PB2 = 1
	SBRS R16, PB3	;PB3 = 1?
	DEC UHOR		;PB3 = 0
					;PB3 = 1
	JMP INT_PC_POP

INT_ESTADO011:	;CONFIG DIA Y MES

	SBRS R16, PB0
	INC UDIA

	SBRS R16, PB1
	DEC UDIA

	SBRS R16, PB2
	INC UMES

	SBRS R16, PB3
	DEC UMES
	
	JMP INT_PC_POP

INT_ESTADO100:	;CONFIG ALARMA

	SBRS R16, PB0
	INC UMINALARM

	SBRS R16, PB1
	DEC UMINALARM

	SBRS R16, PB2
	INC UHORALARM

	SBRS R16, PB3
	DEC UHORALARM

	JMP INT_PC_POP

LIMPIAR_ESTADO:
	CLR ESTADO
	JMP INT_PC_POP

INT_PC_POP:
	SBI PCIFR, PCIF0  //Apagar la bandera de ISR PCINT0
	POP R17
	POP R16
	OUT SREG, R16
	POP R16
	RETI


//****************************************
// INTERRUPCIONES DEL TIMER0
//****************************************


INT_T0:
	LDI R16, 0
	OUT TCCR0A, R16      //inicializacion de timer 0 como contador 
	
	LDI R16, (1<<CS02) | (1<<CS00)     //seleccion de prescaler de 1024 
	OUT TCCR0B, R16       
	
	LDI R16, 100           //valor de conteo inicial 
	OUT TCNT0, R16

	LDI R16, (1<<TOIE0)   
	STS TIMSK0, R16

	RET

INT_TIMER0:
	PUSH R16        //guardamos el valor de R16
 	IN R16, SREG
	PUSH R16

	LDI R16, 100
	OUT TCNT0, R16      
	SBI TIFR0, TOV0

	INC R20			//Incremento por overflow del timer

	POP R16
	OUT SREG, R16
	POP R16

	RETI

/*
INT_T2:
; Establecer los registros TCCR2A y TCCR2B a 0
LDI R16, 0
STS TCCR2A, R16
STS TCCR2B, R16

; Inicializar el contador del timer a 0
STS TCNT2, r16

; Activar el modo de temporizador (normal)
LDI R16, 0
STS TCCR2B, R16

; Establecer el preescalador a 256
LDI R16, (1 << CS22)
STS TCCR2B, R16

; Habilitar la interrupción de desbordamiento del timer
LDI R16, (1 << TOIE2)
sts TIMSK2, r16

RET

INT_TIMER2:
	PUSH R25        ; guardamos el valor de R25
 	IN R25, SREG
	PUSH R25

	LDI R25, 177
	STS TCNT2, R25      ; usamos STS en lugar de OUT para el Timer 2
	SBI TIFR2, TOV2     ; usamos TIFR2 en lugar de TIFR0 para el Timer 2
	
	INC R14           ; realizamos el incremento en las unidades en cada interrupción del timer2

	LDI R25, 50
	SUB R25, R14 
	BRNE SALIR_POP
	CLR R14
	SBI PINB, PB5

SALIR_POP:
	POP R25	
	OUT SREG, R25  
	POP R25         ; Devolvemos el valor antes guardado

	RETI
	*/





